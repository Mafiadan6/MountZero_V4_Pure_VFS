## kernel/Config.in
```kconfig
config MOUNTZERO_V4
	bool "MountZero v4 - VFS hiding without SUSFS"
	depends on KPROBES
	help
	  VFS hiding without SUSFS dependency.
```

## kernel/Kconfig
```kconfig
config MOUNTZERO_V4
	tristate "MountZero v4 - VFS hiding without SUSFS"
	depends on KPROBES
	help
	  This module provides VFS hiding functionality without SUSFS dependency.
	  It supports path hiding, mount hiding, maps hiding, uname spoofing,
	  kstat spoofing, and mount ID remapping.

	  Based on SUSFS4KSU by simonpunk.

	  If unsure, say N.
```
